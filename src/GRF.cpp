#include "pico/stdlib.h"
#include <stdio.h>
#include <math.h>
#include <iostream>
#include <vector>
#include "hardware/i2c.h"
using namespace std;
#ifndef M_PI
#define M_PI 3.14159265358979323846
#endif
#include <cmath>
#include <iostream>
#include <bno08x.h>
#include "utils.h"
// Test 
#include "GRF.h"
#include "hardware/gpio.h"
#include "hardware/adc.h"

extern BNO08x IMU;

float pitch = 0.0f, yaw = 0.0f, roll= 0.0f;
float accX = 0.0f, accY = 0.0f, accZ = 0.0f; // Accelerometer values
float gyroX = 0.0f, gyroY = 0.0f, gyroZ = 0.0f; // Gyroscope values
float angleX = 0.0f, angleY = 0.0f, angleZ = 0.0f; // Angle values
uint16_t adcresult; //starting ADC
bool adcbool = false; //ADC boolean
vector <float> thresholdAngle = {-1.45f};

// // Initialize velocities
vector <float> v_IMU= {0,0,0};
vector <float> v_shank= {0,0,0};
vector <float> v_thigh= {0,0,0};
vector <float> v_knee= {0,0,0};
vector <float> v_hip= {0,0,0};
vector <float> pre_v_shank= {0,0,0};
vector <float> pre_v_thigh= {0,0,0};
vector <float> pre_v_knee= {0,0,0};
vector <float> pre_v_hip= {0,0,0};
vector <float> w_thigh= {0,0,0};
vector <float> w_IMU= {0,0,0};

// Initialize acceleration variables
vector <float> a_IMU = {0,0,0};
vector<float> a_shank = {0,0,0};
vector<float> a_thigh = {0,0,0};
vector<float> a_hip = {0,0,0};
vector<float> pre_a_IMU = {0,0,0};

//Initialize angles
vector <float> pre_angle_thigh = {0,0,0};
vector<float> angle_IMU;

//Initialize length vectors
vector <float> L_shank;
vector <float> L_shank_COM;
vector <float> L_thigh;
vector <float> L_thigh_COM;

// Initialize GRF
vector<float> GRF;

// Lookup table thigh angle
vector<float> LookUp_shank = {-3.14159265358979,
    -3.13530317880783,
    -3.12901370402587,
    -3.12272422924391,
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    3.13530317880783,
    3.14159265358979};
vector<float> LookUp_thigh = {-2.02312674768301,
-2.01864199264022,
-2.01415723759743,
-2.00967248255464,
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2.45714354006460,
};

// Constants
float COM_shank = 0.5726;  // Values taken from paper in Zotero
float COM_thigh = 0.4095;
float dt = 0.005f;  // Time step for 200Hz (5 miliseconds between calculations)
float conversion_factor = 3.3f / (1 << 12); //for ADC

float timeStamp = 0.0f;
int stepDetector = 0;
float stepCounter = 0.0f;
float pre_stepCounter = 0.0f;
float magnitude = 0.0f;
vector<float> angle_thigh;
extern float start_time;

//CHANGE: ALPHA VALUE
float alpha = 0.1f;

// CHANGE: INITIALIZE THE RAW DATA VECTORS
// Raw data vectors
vector<float> a_IMU_raw = {0,0,0};
vector<float> w_IMU_raw = {0,0,0};
vector<float> angle_IMU_raw = {0,0,0};

// Function to compute the length vectors for shank and thigh
vector<float> calculate_length(vector<float> angle, float length){
    float L_x = (length/100) * sin(angle[1]);
    float L_y = 0.00f;
    float L_z = (length/100) * cos(angle[1]);
    return {L_x, L_y, L_z};
}

// Function enrtywise multiplication
vector<float> entrywise_mul(vector<float> L, float COM){
    float L_x = L[0] * COM;
    float L_y = L[1] * COM;
    float L_z = L[2] * COM;
    return{L_x, L_y, L_z};
}

// Function enrtywise addition
vector<float> entrywise_add(vector<float> vect_A, vector<float> vect_B){
    float vect_Cx = vect_A[0] + vect_B[0];
    float vect_Cy = vect_A[1] + vect_B[1];
    float vect_Cz = vect_A[2] + vect_B[2];
    return{vect_Cx, vect_Cy, vect_Cz};
}

// Function to estimate the thigh angle
vector<float> estimate_angle_thigh(vector<float> angle, vector<float> LookUp_shank, vector<float> LookUp_thigh){
    float closest = LookUp_shank[0];
    int closestIndex = 0;
    float minDiff = abs(angle[1] - closest);

    for(int i = 1; i < LookUp_shank.size(); i++){
        float diff = abs(angle[1] - LookUp_shank[i]);
        if(diff < minDiff){
            closest = LookUp_shank[i];
            closestIndex = i;
            minDiff = diff;
        }
    }

    float theta_thigh_x = angle[0];
    float theta_thigh_y = LookUp_thigh[closestIndex];
    float theta_thigh_z = angle[2];
    return{theta_thigh_x, theta_thigh_y, theta_thigh_z};
}

// Function to calculate cross product of two 3D vectores
vector <float> crossProduct(vector <float> vect_A, vector <float> vect_B){
    float cross_Px = vect_A[1] * vect_B[2] - vect_A[2] * vect_B[1];
    float cross_Py = vect_A[2] * vect_B[0] - vect_A[0] * vect_B[2];
    float cross_Pz = vect_A[0] * vect_B[1] - vect_A[1] * vect_B[0];
    return {cross_Px, cross_Py, cross_Pz};
}

    // Function to integrate 
    vector<float> integrate(vector<float> a, vector<float> pre_a, vector<float> v, float dt) {
         float vx = v[0] + 0.5f * (a[0] + pre_a[0]) * dt;
         float vy = v[1] + 0.5f * (a[1] + pre_a[1]) * dt;
         float vz = v[2] + 0.5f * (a[2] + pre_a[2]) * dt;
         return {vx, vy, vz};
    }

    // Function to differentiate
    vector <float> differentiate(vector <float> a, vector <float> pre_a, float dt){
        float bx = (a[0] - pre_a[0]) / dt;
        float by = (a[1] - pre_a[1]) / dt;
        float bz = (a[2] - pre_a[2]) / dt;
    return {bx, by, bz};
    }

    // Function to calculate GRF
    vector <float> calculate_grf(vector <float> a_shank, vector <float> a_thigh, vector <float> a_hip, float m){
        float m_shank = 0.057*m;
        float m_thigh = 0.1416*m;
        float m_hip = 0.5*0.6028*m;
        float g = 9.81;
        float grf_x = m_shank*(a_shank[0]) + m_thigh*(a_thigh[0]) + m_hip*(a_hip[0]);
        float grf_y = m_shank*(a_shank[1]) + m_thigh*(a_thigh[1]) + m_hip*(a_hip[1]);
        float grf_z = m_shank*(a_shank[2]-g) + m_thigh*(a_thigh[2]-g) + m_hip*(a_hip[2]-g);
        return {grf_x, grf_y, grf_z};
    }

    // Function to detect steps based on angle shank (not using this!!)
    // int detect_step_angle(vector <float> angle, vector <float> threshold){
    //     int stepTest;
    //     if(angle[0] < threshold[0]){
    //         stepTest = 1; // Step detected
    //     } else {
    //         stepTest = 0; // No step detected
    //     }
    //     return stepTest;
    // }

    pair<int, float> detect_step_pico(float stepCounter, float pre_stepCounter, float timestamp){
        int stepEvent;
        float timeEvent;
        if(stepCounter == pre_stepCounter){
            stepEvent = 0;
        }
        else {
            stepEvent = 1;
            timeEvent = timestamp;
        }
        return make_pair(stepEvent, timeEvent);
    }

    int detect_step(int stepEvent, float timeEvent, float timeStamp){
        int stepDetector;
            if (timeEvent + 200.0f > timeStamp){
                stepDetector = 1;
            }
            else {
                stepDetector = 0;
            }
            return stepDetector;
    }

    bool ADCthreshold(float adcresult, float conversion_factor){
        bool adcbool;
        if (adcresult * conversion_factor >= 0.03) {
            adcbool = true;
        }
        else {
            adcbool = false;
        }
        return adcbool;
    }

    // Print function
    void print_csv(const vector<float>& times, const vector<vector<float>>& GRFs, const vector<vector<float>>& accelerations, const vector<vector<float>>& gyros, const vector<vector<float>>& angles, const vector<vector<float>>& accelerationsRaw, const vector<vector<float>>& gyrosRaw, const vector<vector<float>>& anglesRaw, const vector<float>& steps , const vector<float>& counter) {
        // Print CSV header
    
        // Iterate through the data and print each row
        for (size_t i = 0; i < times.size(); ++i) {

            printf("%.8f,%.3f,%.3f,%.3f,%.3f,%.3f,%.3f,%.3f,%.3f,%.3f,%.3f,%.3f,%.3f,%.3f,%.3f,%.3f,%.3f,%.3f,%.3f,%.3f,%.3f,%.3f,%.3f,%.3f\n", 
                    times[i],
                    GRFs[i][0], GRFs[i][1], GRFs[i][2],
                    accelerations[i][0], accelerations[i][1], accelerations[i][2],
                    gyros[i][0], gyros[i][1], gyros[i][2],
                    angles[i][0], angles[i][1], angles[i][2],
                    accelerationsRaw[i][0], accelerationsRaw[i][1], accelerationsRaw[i][2],
                    gyrosRaw[i][0], gyrosRaw[i][1], gyrosRaw[i][2],
                    anglesRaw[i][0], anglesRaw[i][1], anglesRaw[i][2],
                    steps[i],
                    counter[i]);
        }
    }
    
    // CHANGE: FILTER IMU
    // Filter IMU data
    vector<float> filter_ema(vector<float> current, vector<float> previous, float alpha) {
        return {
            previous[0] + alpha * (current[0] - previous[0]),
            previous[1] + alpha * (current[1] - previous[1]),
            previous[2] + alpha * (current[2] - previous[2])
        };
    }
    
void get_GRF(float* result, float m, float L_shank_ini, float L_thigh_ini){ 
    if (IMU.getSensorEvent() == false) {
        result[0] = 0.0f;
        result[1] = 0.0f;
        result[2] = -1.0f;
        result[3] = 0.0f;
        return; // No sensor event, exit the function
    }

    // Read sensor data
    if (IMU.getSensorEvent() == true){
    
        // CHANGE: SENSORIDS
        if (IMU.getSensorEventID() == SENSOR_REPORTID_GAME_ROTATION_VECTOR) {   
            yaw = IMU.getGameYaw();
            pitch = IMU.getGamePitch();
            roll = IMU.getRoll();
        }
        
        if (IMU.getSensorEventID() == SENSOR_REPORTID_LINEAR_ACCELERATION) {
            accX = IMU.getLinAccelX();
            accY = IMU.getLinAccelY();
            accZ = IMU.getLinAccelZ();
        }
        
        if (IMU.getSensorEventID() == SENSOR_REPORTID_GYROSCOPE_CALIBRATED) {
            gyroX = IMU.getGyroX();
            gyroY = IMU.getGyroY();
            gyroZ = IMU.getGyroZ();
        }
        
        timeStamp = (time_us_64() / 1000.0f) - start_time; // Time in seconds

        if (IMU.getSensorEventID() == SENSOR_REPORTID_STEP_COUNTER) {
            stepCounter = IMU.getStepCount();
        }

    }

    // CHANGE: RAW DATA AND FILTERED DATA
    // Store sensor data in vector
    a_IMU_raw = {accZ, accY, accX};
    w_IMU_raw = {gyroZ, gyroY, gyroX};
    angle_IMU_raw = {roll, pitch, yaw};

    // Filter sensor data
    a_IMU = filter_ema(a_IMU_raw, a_IMU, alpha);
    w_IMU = filter_ema(w_IMU_raw, w_IMU, alpha);
    angle_IMU = angle_IMU_raw;
    
    angle_thigh = estimate_angle_thigh(angle_IMU, LookUp_shank, LookUp_thigh);

    // Calculate Length vectors
    L_shank= calculate_length(angle_IMU, L_shank_ini);
    L_shank_COM = entrywise_mul(L_shank, COM_shank);
    L_thigh= calculate_length(angle_thigh, L_thigh_ini);
    L_thigh_COM = entrywise_mul(L_thigh, (1-COM_thigh));

    // Integrate a_IMU to obtain v_IMU
    v_IMU= integrate(a_IMU, pre_a_IMU, v_IMU, dt);
    
    // Calculate velocity and acceleration shank
    v_shank = entrywise_add(v_IMU, crossProduct(w_IMU,L_shank_COM));
    a_shank = differentiate(v_shank, pre_v_shank, dt);

    // Calculate velocity knee
    v_knee= entrywise_add(v_IMU, crossProduct(w_IMU,L_shank));

    // Calculate velocity and acceleration thigh
    w_thigh = differentiate(angle_thigh, pre_angle_thigh, dt);
    v_thigh= entrywise_add(v_knee, crossProduct(w_thigh,L_thigh_COM));
    a_thigh = differentiate(v_thigh, pre_v_thigh, dt);

    // Calculate velocity and acceleration hip
    v_hip= entrywise_add(v_knee, crossProduct(w_thigh,L_thigh));
    a_hip = differentiate(v_hip, pre_v_hip, dt);


    //stepDetector = detect_step_angle(angle_IMU, thresholdAngle);
    auto [stepEvent, timeEvent] = detect_step_pico(stepCounter, pre_stepCounter, timeStamp);
    stepDetector = detect_step(stepEvent, timeEvent, timeStamp);

    // Assign current value to previous value
    pre_angle_thigh = angle_thigh;
    pre_v_thigh = v_thigh;
    pre_v_hip = v_hip;
    pre_v_shank = v_shank;
    pre_a_IMU = a_IMU;
    pre_stepCounter = stepCounter;

    // Calculate GRF
    GRF = calculate_grf(a_shank, a_thigh, a_hip, m);

    // Return GRF, timestamp, stepDetector timeEvent for transmission
    magnitude = sqrt(GRF[0]*GRF[0] + GRF[1]*GRF[1] + GRF[2]*GRF[2]);    
    result[0] = magnitude;
    result[1] = timeStamp;
    result[2] = (float)stepDetector;
    result[3] = timeEvent;
}
